## components/lora_device_lib/Kconfig.projbuild
```kconfig
menu "LoRa settings"

	choice LORA_LORAWAN_VERSION
        prompt "LoRaWAN version"      
        default LORA_LORAWAN_VERSION_1_1

        config LORA_LORAWAN_VERSION_1
            bool "1.0"
        config LORA_LORAWAN_VERSION_1_1
            bool "1.1"
    endchoice
    
    choice LORA_FREQUENCY
        prompt "LoRaWAN version"      
        default LORA_FREQUENCY_EU_863_870

        config LORA_FREQUENCY_EU_863_870
            bool "EU 868-780MHz"
        config LORA_FREQUENCY_EU_443
            bool "EU 443MHz"
        config LORA_FREQUENCY_US_902_928
            bool "US 902-928MHz"
        config LORA_FREQUENCY_AU_915_928
            bool "AU 915-928MHz"
    endchoice

endmenu
```

## main/Kconfig.projbuild
```kconfig
menu "Sensor settings"
	
	choice SENSOR_TYPE
        prompt "Internal sensor type"      
        default SENSOR_TYPE_DHT10

        config SENSOR_TYPE_DHT10
            bool "DHT10"
        config SENSOR_TYPE_DHT22
            bool "DHT22"
    endchoice

	choice SENSOR_PROFILE
        prompt "Sensor profile"      
        default SENSOR_PROFILE_DEFAULT

        config SENSOR_PROFILE_DEFAULT
            bool "Default"
            help
                 Measure temperature and humdity trought internal sensor
        config SENSOR_PROFILE_SOIL_MOSTURE
            bool "Soil mostuire"
            help
                 Measure soil moisture
    endchoice

endmenu
```

## sdkconfig.defaults
```kconfig
#
# BT config
#
CONFIG_BT_ENABLED=y
CONFIG_BTDM_CTRL_MODE_BLE_ONLY=y
CONFIG_BTDM_CTRL_MODE_BR_EDR_ONLY=n
CONFIG_BTDM_CTRL_MODE_BTDM=n

# Use lower CPU frequency
CONFIG_ESP32_DEFAULT_CPU_FREQ_80=y
```
